## project/buildsys/Kconfig
```kconfig
mainmenu "Project configuration"

config WORK_DIR
	string
	option env="WORK_DIR"

config SPEC_CFG
	string
	option env="SPEC_CFG"

source "$SPEC_CFG"
```

## regression/Kconfig
```kconfig
config BROKEN_PRINTF
bool
help
	Some configurations break their libc, and thus cause the test suite to
	break in exciting ways. This disables the test suite.

menu "Tests"
	depends on !BROKEN_PRINTF

	config SIMULATED_TESTING
	bool "Simulated testing"
	default y if QUICK_SIM
	default n
	help
		Use the simulator for testing. For MIPS, CONFIG_MIPS_MODEL
		specifies the simulator model to use. Requires Codescape
		Professional.

	config ACQUIRE_FOR_TEST
	bool "Acquire probe for testing"
	default y if QUICK_PROBE
	default n
	help
		Automatically acquire a probe for testing. For MIPS,
		CONFIG_MIPS_MODEL specifies either a bitstream or a board to
		use.

	menu "Basic"

		config TEST_lsttest
		bool "Single linked list test"
		default y
		help
			A basic functionality test for the LST module.

		config TEST_dqtest
		bool "Double linked queue test"
		default y
		help
			A basic functionality test for the DQ module.

		config TEST_tretest
		bool "Tree test"
		default y
		help
			A basic functionality test for the TRE module.

		config TEST_cppbuild
		bool "C++ build test"
		default y
		help
			This test ensures that the MEOS headers are compatible with C++.

		config TEST_warning
		bool "Warning test"
		depends on DEBUG_DIAGNOSTICS
		default y
		help
			Test DBG_warning interception.

		config TEST_noisy_stack
		bool "Noisy stack test"
		default y
		help
			Test that task initialisation functions can deal with stack noise.

		config TEST_stack_overflow
		bool "Stack overflow test"
		default y
		depends on DEBUG_DIAGNOSTICS && !ARCH_LINUX
		help
			Test that stack overflows may be detected.

		config TEST_infwait
		bool "Infinite wait test"
		default y
		help
			Test that infinite waits work as expected.

		config TEST_timisrorder
		bool "Timer ISR order test"
		depends on TIMISR
		default y
		help
			Test that timer ISRs occur in activation order.

		config TEST_takepool_int
		bool "KRN_takePool in ISR test"
		default y
		help
			Ensure that KRN_takePool works from an ISR.

		config TEST_error
		bool "Error test"
		depends on DEBUG_DIAGNOSTICS
		default y
		help
			Test DBG_assert interception.

		config TEST_coverage
		bool "Coverage test"
		depends on DEBUG_DIAGNOSTICS
		default n if DEBUG_PARANOIA
		default y
		help
			This test unit tests all the base modules, and some glue code. It
			should cover almost all non-interprocessor related code.

		config TEST_lazy
		bool "Lazy context switching test"
		depends on !SIMULATED_TESTING
		default y
		help
			Test lazy context switching.

		config TEST_isr_schedule
		bool "ISR scheduling test"
		default y
		help
			Ensure that scheduling within an interrupt behaves as expected.

		config TEST_unaligned_task
		bool "Unaligned task test"
		default y
		help
			Test that MEOS will deal with unaligned task stacks correctly.

		config TEST_raiseipl_timeout
		bool "Raise IPL timeout test"
		default y
		help
			This test ensures that timeouts during raised IPL behave properly.

		config TEST_intsynth
		bool "Interrupt synthesis test"
		depends on TEST_INTSYNTH_ENABLE
		default y
		help
			This test ensures that synthesised interrupts are routed to the core.

		config TEST_softint
		bool "Soft interrupt test"
		default y
		help
			This test ensures that soft interrupts work.

		config TEST_sync
		bool "Sync test"
		default y
		help
			This test ensures that KRN_sync() works.

	endmenu

	menu "FPU"

		config TEST_FPU_paranoia
		bool "FPU_paranoia"
		default y
		help
			Run multiple copies of the standard "FPU paranoia" test, configure
			for double precision, with tim slicing. This stresses the FPU
			context switching mechanism.

		config TEST_FPU_paranoia_single
		bool "FPU_paranoia_single"
		default y
		help
			Run multiple copies of the standard "FPU paranoia" test, configured
			for single precision, with time slicing. This stresses the FPU
			context switching mechanism.

	endmenu

	menu "Interprocessor"

		config TEST_interThread
		bool "Import/export interthreading test"
		depends on FEATURE_IMPEXP
		default n if ARCH_LINUX
		default n if DEBUG_PARANOIA
		default y
		help
			Test the import/export mechanism.

		config TEST_mbxstress
		bool "Mailbox stress test"
		depends on FEATURE_IMPEXP
		default n if ARCH_LINUX
		default y
		help
			Stress the import/export mechanism with mailbox traffic.

		config TEST_mtmath
		bool "Multiprocessor math test"
			depends on FEATURE_IMPEXP
		default n if ARCH_LINUX
		default y
		help
			Test math performance between multiple processors.

		config TEST_MTMATH_N
		depends on TEST_mtmath
		int "Number of samples to average"
		range 0 4096
		default 128
		help
			Specifies the number of samples the multiprocessor math
			test should take for each statistic.


	endmenu

	menu "Metrics"

		config TEST_size
		bool "size"
		default y
		help
			Generate a table of code/data sizes for the library generated by the
			current MEOS configuration. Note that in practice, some of this
			may not be linked to the user application.

		config TEST_usage
		bool "usage"
		depends on DEBUG_STACK_CHECKING
		default y
		help
			Measure the minimum stack usage for various MEOS tasks.

		config TEST_timing
		bool "timing"
		depends on !SIMULATED_TESTING && !ARCH_LINUX && !(QUICK_DEBUG && QUICK_PROBE)
		default y
		help
			Provide detailed timing data for MEOS operations in the current
			configuration.

		config TEST_TIMING_N
		depends on TEST_timing
		int "Number of samples to average"
		range 0 4096
		default 128
		help
			Specifies the number of samples the timing test should take for each
			statistic.

	endmenu

	menu "Supported packages"

		source "$WORK_DIR/support/Kconfig-test"

	endmenu

source "$WORK_DIR/targets/linux/regression/Kconfig"
source "$WORK_DIR/targets/mips/regression/Kconfig"

endmenu
```

## support/1/cpio/Kconfig
```kconfig
config CPIO
bool "CPIO Filesystem"
depends on MASS
default n
help
	A simple read only filesystem based on CPIO.
```

## support/1/demos/Kconfig
```kconfig
config DEMO_eliza
bool "Eliza serial demo"
default n
depends on ARCH_MIPS_PIC || ARCH_MIPS_GIC
help
	A demonstration of serial I/O, using Eliza.

config DEMO_ckw_gpio
bool "ChipKit Wi-Fire GPIO demo"
default n
depends on ARCH_MIPS_PIC
help
	A demonstration of GPIO and interrupts, using the buttons and LEDs on
	the ChipKit Wi-Fire.

config DEMO_mrf24g
bool "ChipKit Wi-Fire MRF24G demo"
default n
depends on DRIVER_MRF24G
help
	A demonstration of scanning with the MRF24G.

config DEMO_timed_paranoia
bool "Timed FPU Paranoia"
default n
help
	A version of FPU paranoia that is timed with performance counters.

config DEMO_web_page
bool "lwIP web page demo"
default n
depends on LWIP
help
	LwIP demo displaying an interactive web page.

config DEMO_mipsFPGA_demo
bool "MIPS FPGA demo"
default n
depends on LWIP && ARCH_MIPS_BASELINE_XPSINTC
help
	MIPS FPGA demo.

config DEMO_tftp_demo
bool "tftp demo"
default n
depends on TFTP
help
	TFTP demo reading a file from a TFTP server.

config DEMO_srtc_demo
bool "srtc demo"
default n
depends on SNTP && SRTC
help
	SRTC demo.

config DEMO_mvz_static
bool "MEOS-VZ static demo"
default y
depends on MVZ
depends on !MVZ_TLB_REFILL
help
	MEOS-VZ static demo.

config DEMO_mvz_dynamic
bool "MEOS-VZ dynamic demo"
default y
depends on MVZ
depends on MVZ_TLB_REFILL
help
	MEOS-VZ dynamic demo.

config DEMO_mvz_comms
bool "MEOS-VZ communications demo"
default y
depends on MVZ
depends on !MVZ_TLB_REFILL
help
	MEOS-VZ communications demo.


config DEMO_hello
bool "MEOS-VZ hello demo"
default y
help
	Guest for MEOS-VZ static demo.

config DEMO_simplexmit
bool "MEOS-VZ simple transmit demo"
default y
help
	Guest for MEOS-VZ communication demo.

config DEMO_simplerecv
bool "MEOS-VZ simple receive demo"
default y
help
	Guest for MEOS-VZ communication demo.
```

## support/1/drivers/Kconfig
```kconfig
menu "Drivers"

menu "UART"
source "$WORK_DIR/support/1/drivers/uart/Kconfig"
source "$WORK_DIR/support/1/drivers/fdc/Kconfig"
source "$WORK_DIR/support/1/drivers/ns16550a/Kconfig"
source "$WORK_DIR/support/1/drivers/pic32uart/Kconfig"
source "$WORK_DIR/support/1/drivers/tcpsocket/Kconfig"
source "$WORK_DIR/support/1/drivers/virtioconsole/Kconfig"
endmenu

menu "Ethernet"
source "$WORK_DIR/support/1/drivers/lan9211/Kconfig"
source "$WORK_DIR/support/1/drivers/mrf24g/Kconfig"
source "$WORK_DIR/support/1/drivers/virtionet/Kconfig"
source "$WORK_DIR/support/1/drivers/xpsethlite/Kconfig"
source "$WORK_DIR/support/1/drivers/dwethgmac/Kconfig"
endmenu

endmenu
```

## support/1/drivers/dwethgmac/Kconfig
```kconfig
config DRIVER_DWETHGMAC
depends on LWIP
bool "DesignWare Ethernet GMAC"
help
	DesignWare Ethernet GMAC driver.

config DRIVER_DWETHGMAC_NUM_DESCS
depends on DRIVER_DWETHGMAC
int "Number of DMA buffers"
default 32
help
	Specifies the number of DMA buffers reserved each for transmit and
	receive.
```

## support/1/drivers/fdc/Kconfig
```kconfig
menuconfig DRIVER_FDC
bool "FDC"
default Y
select DRIVER_UART
help
	Driver for the MIPS FDC.

config DRIVER_FDC_TX_BUFFER
int "Default Tx buffer size"
default 128
depends on DRIVER_FDC
help
	Default transmission buffer size. May be overridden by initialisation.

config DRIVER_FDC_RX_BUFFER
int "Default Rx buffer size"
default 128
depends on DRIVER_FDC
help
	Default transmission buffer size. May be overridden by initialisation.
```

## support/1/drivers/lan9211/Kconfig
```kconfig
config DRIVER_LAN9211
depends on LWIP
bool "LAN9211"
help
	LAN9211 ethernet driver.
```

## support/1/drivers/ns16550a/Kconfig
```kconfig
menuconfig DRIVER_NS16550A
bool "NS 16550A"
default Y
select DRIVER_UART
help
	Driver for the NS16550A UART and compatible devices.

config DRIVER_NS16550A_TX_BUFFER
int "Default Tx buffer size"
default 128
depends on DRIVER_NS16550A
help
	Default transmission buffer size. May be overridden by initialisation.

config DRIVER_NS16550A_RX_BUFFER
int "Default Rx buffer size"
default 128
depends on DRIVER_NS16550A
help
	Default transmission buffer size. May be overridden by initialisation.
```

## support/1/drivers/pic32uart/Kconfig
```kconfig
menuconfig DRIVER_PIC32_UART
bool "PIC32 UART"
default Y
select DRIVER_UART
help
	Driver for the PIC32 UART and compatible devices.

config DRIVER_PIC32_UART_TX_BUFFER
int "Default Tx buffer size"
default 128
depends on DRIVER_PIC32_UART
help
	Default transmission buffer size. May be overridden by initialisation.

config DRIVER_PIC32_UART_RX_BUFFER
int "Default Rx buffer size"
default 128
depends on DRIVER_PIC32_UART
help
	Default transmission buffer size. May be overridden by initialisation.
```

## support/1/drivers/tcpsocket/Kconfig
```kconfig
menuconfig DRIVER_TCPSOCKET
bool "TCP socket"
default Y
select DRIVER_UART
help
	UART compliant driver that communicates over a TCP/IP socket.

config DRIVER_TCPSOCKET_TX_BUFFER
int "Default Tx buffer size"
default 32768
depends on DRIVER_TCPSOCKET
help
	Default transmission buffer size. May be overridden by initialisation.

config DRIVER_TCPSOCKET_RX_BUFFER
int "Default Rx buffer size"
default 32768
depends on DRIVER_TCPSOCKET
help
	Default transmission buffer size. May be overridden by initialisation.
```

## support/1/drivers/virtioconsole/Kconfig
```kconfig
menuconfig DRIVER_VIRTIO_CONSOLE
bool "Virtio console"
default Y
select DRIVER_UART
help
	Driver for the Virtio console.

config DRIVER_VIRTIO_CONSOLE_TX_BUFFER
int "Default Tx buffer size"
default 128
depends on DRIVER_VIRTIO_CONSOLE
help
	Default transmission buffer size. May be overridden by initialisation.

config DRIVER_VIRTIO_CONSOLE_RX_BUFFER
int "Default Rx buffer size"
default 128
depends on DRIVER_VIRTIO_CONSOLE
help
	Default transmission buffer size. May be overridden by initialisation.
```

## support/1/drivers/virtionet/Kconfig
```kconfig
config DRIVER_VIRTIO_NET
depends on LWIP
bool "Virtio network"
help
	Virtio network driver.
```

## support/1/drivers/xpsethlite/Kconfig
```kconfig
config DRIVER_XPSETHLITE
depends on LWIP
depends on ARCH_MIPS_BASELINE_XPSINTC
bool "Xilinx XPS Ethernet Lite"
help
	Driver for the ethernet on the MIPS NEXYS4DDR FPGA system.
```

## support/1/lopri/Kconfig
```kconfig
menuconfig LOPRI
bool "Low priority work queue"

config LOPRI_STACKSIZE
int "Worker stack size"
depends on LOPRI
default 4096

config LOPRI_JOBS
int "Number of job slots"
depends on LOPRI
default 16
```

## support/1/mass/Kconfig
```kconfig
config MASS_RAM
bool "RAM/ROM disk support"
depends on MASS
default n
help
	Memory backed file system support.

config MASS_PARTITION
bool "Partitioning support"
depends on MASS
default n
help
	Virtual device that represents a subset of another device.
```

## support/1/mvz/Kconfig
```kconfig
config MVZ
bool "MEOS-VZ hypervisor extensions"
default n
depends on ARCH_MIPS_VZ
depends on FEATURE_VRINGS
help
	Turn MEOS into a hypervisor.

config MVZ_TLB_REFILL
bool "Dynamic TLB"
default y
depends on MVZ
help
	Allows the hosting of dynamic systems through the use of a TLB refill
	handler. Disables MVZ_fixMapping and enables MVZ_addMapping.
	Guest execution will potentially be slower.

choice
	prompt "Page size"
	depends on MVZ_TLB_REFILL
	default MVZ_4KB_PAGES
	help
		Selects the page size to be used with the TLB. Larger is faster,
		but limits the alignment of the source memory and increases the
		minimum usable size.

	config MVZ_4KB_PAGES
	bool "4KB"
	help
		Use 4KB pages.

	config MVZ_16KB_PAGES
	bool "16KB"
	help
		Use 16KB pages.

	config MVZ_64KB_PAGES
	bool "64KB"
	help
		Use 64KB pages.

	config MVZ_256KB_PAGES
	bool "256KB"
	help
		Use 256KB pages.

	config MVZ_1MB_PAGES
	bool "1MB"
	help
		Use 1MB pages.

	config MVZ_4MB_PAGES
	bool "4MB"
	help
		Use 4MB pages.

	config MVZ_16MB_PAGES
	bool "16MB"
	help
		Use 16MB pages.

	config MVZ_64MB_PAGES
	bool "64MB"
	help
		Use 64MB pages.

	config MVZ_256MB_PAGES
	bool "256MB"
	help
		Use 256MB pages.

endchoice

config MVZ_CLEAN_NET
bool "Filter network packets by MAC"
default n
depends on MVZ
depends on LWIP
help
	By default, incoming network packets will be forwarded to all guests
	sharing an interface. This setting provides privacy by only forwarding
	incoming packets that are addressed to the MAC declared by the guest.
	It should be noted that this is only as secure as your network fabric,
	which in most cases will easily be snooped with a computer running
	Wireshark.

config MVZ_BROKEN_TIMERS
bool "Emulate guest timers"
default n
depends on MVZ
help
	Some implementations of VZ do not connect the guest CP0 count/compare
	timer signal to the guest interrupt system, meaning there will be no
	virtual timer interrupts. This emulates expected guest timer operation
	through interrupt synthesis.

config MVZ_ACK_VIA_CAUSE
bool "Guest interrupt acknowledgement via cause"
default n
depends on MVZ
help
	Allows a guest to set and clear the IPn bits. This provides an easy way
	for a guest to deassert an interrupt, without emulating hardware.
```

## support/1/sntp/Kconfig
```kconfig
menuconfig SNTP
bool "SNTP client"
depends on SRTC
depends on IP
default n
help
	Build a Simple Network Time Protocol client.

if SNTP

config SNTP_DEFAULT
string "Default SNTP server"
default "217.114.59.66" #0.uk.pool.ntp.org
help
	IP address of NTP server. Defaults to 0.uk.pool.ntp.org

config SNTP_TIMEOUT
int "SNTP timeout"
default 5000
help
	Number of milliseconds to wait for a response.

endif
```
